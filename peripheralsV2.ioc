# file: peripheralsV2.ioc
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Mcu.Family=STM32F4
Mcu.Name=STM32F429ZITx
Mcu.Package=LQFP144
NVIC.PriorityGroup=NVIC_PRIORITYGROUP_4
PA13.Mode=Serial_Wire
PA13.Signal=SYS_JTMS-SWDIO
PA14.Mode=Serial_Wire
PA14.Signal=SYS_JTCK-SWCLK
PH0/OSC_IN.Mode=HSE-External-Oscillator
PH0/OSC_IN.Signal=RCC_OSC_IN
PH1/OSC_OUT.Mode=HSE-External-Oscillator
PH1/OSC_OUT.Signal=RCC_OSC_OUT
ProjectManager.HeapSize=0x200
ProjectManager.StackSize=0x400
ProjectManager.TargetToolchain=SW4STM32
RCC.48MHZClocksFreq_Value=32000000
RCC.AHBCLKDivider=RCC_SYSCLK_DIV4
RCC.AHBFreq_Value=16000000
RCC.APB1Freq_Value=16000000
RCC.APB1TimFreq_Value=16000000
RCC.APB2Freq_Value=16000000
RCC.APB2TimFreq_Value=16000000
RCC.CortexFreq_Value=16000000
RCC.HCLKFreq_Value=16000000
RCC.HSE_VALUE=25000000
RCC.HSI_VALUE=16000000
RCC.LSE_VALUE=32768
RCC.PLLM=8
RCC.PLLN=64
RCC.SYSCLKFreq_VALUE=64000000
RCC.SYSCLKSource=RCC_SYSCLKSOURCE_PLLCLK
RCC.VCOOutputFreq_Value=128000000
board=custom

// file: Src/main.c
/* USER CODE BEGIN Header */
/**
  ******************************************************************************
  * @file           : main.c
  * @brief          : Main program body
  ******************************************************************************
  * @attention
  *
  * <h2><center>&copy; Copyright (c) 2019 STMicroelectronics.
  * All rights reserved.</center></h2>
  *
  * This software component is licensed by ST under BSD 3-Clause license,
  * the "License"; You may not use this file except in compliance with the
  * License. You may obtain a copy of the License at:
  *                        opensource.org/licenses/BSD-3-Clause
  *
  ******************************************************************************
  */
/* USER CODE END Header */

#include "main.h"

/* USER CODE BEGIN Includes */
#include "rcc.h"
#include "gpio.h"
#include "spi.h"
#include "stateMachine.h"
#include "timer.h"
/* USER CODE END Includes */

void SystemClock_Config(void);
static void MX_GPIO_Init(void);

/* USER CODE BEGIN 0 */
volatile uint8_t slaveMsg = 0;
volatile uint8_t masterMsg = 0;
SMInfo smInfo;
MasterInfo masterInfo;
/* USER CODE END 0 */

int main(void)
{
  /* USER CODE BEGIN 1 */

	RCC->APB2RSTR |= RCC_APB2RSTR_SPI1RST | RCC_APB2RSTR_SPI4RST | RCC_APB2RSTR_TIM1RST;
	RCC->APB2RSTR &= ~(RCC_APB2RSTR_SPI1RST | RCC_APB2RSTR_SPI4RST | RCC_APB2RSTR_TIM1RST);
	RCC->APB2ENR |= (RCC_APB2ENR_SPI1EN | RCC_APB2ENR_SPI4EN | RCC_APB2ENR_TIM1EN);

	RCC->AHB1RSTR |= RCC_AHB1RSTR_GPIOERST | RCC_AHB1RSTR_GPIOARST			\
			| RCC_AHB1RSTR_GPIOBRST | RCC_AHB1RSTR_GPIOGRST;
	RCC->AHB1RSTR &= ~(RCC_AHB1RSTR_GPIOERST | RCC_AHB1RSTR_GPIOARST 		\
			| RCC_AHB1RSTR_GPIOBRST | RCC_AHB1RSTR_GPIOGRST);
	RCC->AHB1ENR |= (RCC_AHB1ENR_GPIOEEN | RCC_AHB1ENR_GPIOAEN 				\
			| RCC_AHB1ENR_GPIOBEN | RCC_AHB1ENR_GPIOGEN);

	/*
	 * PG13	green LED
	 * PA0	blue button
	 */
	configGPIOWithoutAF(GPIOA,0,GPIO_INPUT,0,VERY_HIGH_SPEED,PULL_DOWN);
	configGPIOWithoutAF(GPIOG,13,GPIO_OUTPUT,OUTPUT_PUSH_PULL			\
				,HIGH_SPEED,NO_PUPD);
	/*
	 * SPI1.NSS PA4
	 * SPI1.CLK PA5
	 * SPI1.MISO PB4
	 * SPI1.MOSI PB5
	 */
	configGPIO(GPIOA,4,GPIO_ALT_FUNC,OUTPUT_PUSH_PULL			\
			,HIGH_SPEED,NO_PUPD,AF5);
	configGPIO(GPIOA,5,GPIO_ALT_FUNC,OUTPUT_PUSH_PULL		\
			,HIGH_SPEED,NO_PUPD,AF5);
	configGPIO(GPIOB,4,GPIO_ALT_FUNC,OUTPUT_PUSH_PULL			\
			,HIGH_SPEED,NO_PUPD,AF5);
	configGPIO(GPIOB,5,GPIO_ALT_FUNC,OUTPUT_PUSH_PULL		\
			,HIGH_SPEED,NO_PUPD,AF5);

	/*
	 * SPI4_SCK    PE2
	 * SPI4_NSS    PE4
	 * SPI4_MISO   PE5
	 * SPI4_MOSI   PE6
	 */
	configGPIO(GPIOE,2,GPIO_ALT_FUNC,OUTPUT_PUSH_PULL			\
				,HIGH_SPEED,NO_PUPD,AF5);
	configGPIO(GPIOE,4,GPIO_ALT_FUNC,OUTPUT_PUSH_PULL			\
				,HIGH_SPEED,NO_PUPD,AF5);
	configGPIO(GPIOE,5,GPIO_ALT_FUNC,OUTPUT_PUSH_PULL			\
				,HIGH_SPEED,NO_PUPD,AF5);
	configGPIO(GPIOE,6,GPIO_ALT_FUNC,OUTPUT_PUSH_PULL			\
				,HIGH_SPEED,NO_PUPD,AF5);
	/*
	 * SPI1:master
	 * SPI4:slave
	 */
	spiConfig(SPI1,F_PCLK_DIV_256 | UNIDIRECT_DATA_MODE_TWO_LINE	\
			| DATA_FRAME_8_BIT | FULL_DUPLEX | MSTR_MASTER_CONFIG	\
			| FRF_SPI_MOTOROLA | CPOL_CK0_WHEN_IDLE					\
			| CPHA_FIRST | SPI_MSB_FIRST | SSOE_1);

	spiConfig(SPI4,F_PCLK_DIV_256 | UNIDIRECT_DATA_MODE_TWO_LINE	\
			| DATA_FRAME_8_BIT | FULL_DUPLEX | MSTR_SLAVE_CONFIG	\
			| FRF_SPI_MOTOROLA | CPOL_CK0_WHEN_IDLE					\
			| CPHA_FIRST | SPI_MSB_FIRST | RXNEIE_NOT_MASK);

	//TIM1:
	//OPM,update interrupt
	//configAdvancedTIM(TIM1, TIMx_CR1_OPM);
	configPSC(TIM1,16000000,0.001);
	configARR(TIM1,25);
	config_DMA_ISR(TIM1,TIMx_DIER_UIE);
	configAdvancedTIM(TIM1,TIMx_CR1_OPM);

	//TIM1 update interrupt
	nvicEnableInterrupt(25);

	//SPI4 interrupt
	nvicEnableInterrupt(84);
  /* USER CODE END 1 */

  /* MCU Configuration--------------------------------------------------------*/

  /* Reset of all peripherals, Initializes the Flash interface and the Systick. */
  HAL_Init();

  /* Configure the system clock */
  SystemClock_Config();

  /* Initialize all configured peripherals */
  MX_GPIO_Init();
  /* USER CODE BEGIN 2 */
  spiEnable(SPI1);
  spiEnable(SPI4);

  configAdvancedTIM(TIM1,TIMx_CR1_COUNT_EN);

  //slaveMsg = receiveData(SPI4);
  //masterMsg = receiveData(SPI1);

  /* USER CODE END 2 */

  /* Infinite loop */
  while (1)
  {

  }
}

void SystemClock_Config(void)
{
  RCC_OscInitTypeDef RCC_OscInitStruct = {0};
  RCC_ClkInitTypeDef RCC_ClkInitStruct = {0};

  /** Configure the main internal regulator output voltage
  */
  __HAL_RCC_PWR_CLK_ENABLE();
  __HAL_PWR_VOLTAGESCALING_CONFIG(PWR_REGULATOR_VOLTAGE_SCALE3);
  /** Initializes the CPU, AHB and APB busses clocks
  */
  RCC_OscInitStruct.OscillatorType = RCC_OSCILLATORTYPE_HSI;
  RCC_OscInitStruct.HSIState = RCC_HSI_ON;
  RCC_OscInitStruct.HSICalibrationValue = RCC_HSICALIBRATION_DEFAULT;
  RCC_OscInitStruct.PLL.PLLState = RCC_PLL_ON;
  RCC_OscInitStruct.PLL.PLLSource = RCC_PLLSOURCE_HSI;
  RCC_OscInitStruct.PLL.PLLM = 8;
  RCC_OscInitStruct.PLL.PLLN = 64;
  RCC_OscInitStruct.PLL.PLLP = RCC_PLLP_DIV2;
  RCC_OscInitStruct.PLL.PLLQ = 4;
  if (HAL_RCC_OscConfig(&RCC_OscInitStruct) != HAL_OK)
  {
    Error_Handler();
  }
  /** Initializes the CPU, AHB and APB busses clocks
  */
  RCC_ClkInitStruct.ClockType = RCC_CLOCKTYPE_HCLK|RCC_CLOCKTYPE_SYSCLK
                              |RCC_CLOCKTYPE_PCLK1|RCC_CLOCKTYPE_PCLK2;
  RCC_ClkInitStruct.SYSCLKSource = RCC_SYSCLKSOURCE_PLLCLK;
  RCC_ClkInitStruct.AHBCLKDivider = RCC_SYSCLK_DIV4;
  RCC_ClkInitStruct.APB1CLKDivider = RCC_HCLK_DIV1;
  RCC_ClkInitStruct.APB2CLKDivider = RCC_HCLK_DIV1;

  if (HAL_RCC_ClockConfig(&RCC_ClkInitStruct, FLASH_LATENCY_0) != HAL_OK)
  {
    Error_Handler();
  }
}

static void MX_GPIO_Init(void)
{

  /* GPIO Ports Clock Enable */
  __HAL_RCC_GPIOH_CLK_ENABLE();
  __HAL_RCC_GPIOA_CLK_ENABLE();

}

/* USER CODE BEGIN 4 */

void SPI4_IRQHandler(void){
	if(SPI4->SR & RXNE_NOT_EMPTY){
		slaveMsg = (SPI4->DR & 0xff);
	}
	smInfo.slaveMsg=slaveMsg;
	if(slaveMsg==0x23){
		smInfo.state=READ_BUTTON_COMMAND;
	}else if(slaveMsg==0x45){
		smInfo.state=CONTROL_LED_COMMMAND;
	}
	stateMachineSlaveV2(&smInfo);
	//SPI4->SR &= ~(RXNE_NOT_EMPTY);
}

void TIM1_UP_TIM10_IRQHandler(void){
	stateMachineMaster(&masterInfo);
	TIM1->SR &= ~(TIMx_SR_UIF);
	configAdvancedTIM(TIM1,TIMx_CR1_COUNT_EN);
}

/* USER CODE END 4 */

void Error_Handler(void)
{
}

/************************ (C) COPYRIGHT STMicroelectronics *****END OF FILE****/
